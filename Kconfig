## Kconfig
```kconfig
config CORNE_DIAGNOSTICS
    bool "Corne input and BLE diagnostic observers"
    depends on ZMK_BLE && ZMK_SPLIT
    default n
    help
      Log input events, queue failures, HID and split notification submissions,
      and connection state. No protocol, retry, or connection preference changes.
```

## config/west.yml
```yaml
manifest:
  remotes:
    - name: zmkfirmware
      url-base: https://github.com/zmkfirmware
  projects:
    - name: zmk
      remote: zmkfirmware
      # Verified upstream main on 2026-09-16; intentionally not floating.
      revision: 9ebbeff0a8b69a42f14aec022cdf16c7a107b9e0
      import: app/west.yml
    # Override ZMK's moving v4.1.0+zmk-fixes branch as well.
    - name: zephyr
      remote: zmkfirmware
      revision: 10ba6d0cb38bc3d258775d27982f707599320085
      import:
        name-blocklist:
          - ci-tools
          - hal_altera
          - hal_cypress
          - hal_infineon
          - hal_microchip
          - hal_nxp
          - hal_openisa
          - hal_xtensa
          - hal_st
          - hal_ti
          - loramac-node
          - mcuboot
          - mcumgr
          - net-tools
          - openthread
          - edtt
          - trusted-firmware-m
  self:
    path: config
```
